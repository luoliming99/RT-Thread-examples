/**
  ******************************************************************************
  * @file    main.c
  * @author  fire
  * @version V1.0
  * @date    2018-xx-xx
  * @brief   RT-Thread 3.0 + SMT32 工程模板
  ******************************************************************************
  * @attention
  *
  * 实验平台:野火 F103-MINI STM32 开发板 
  * 论坛    :http://www.firebbs.cn
  * 淘宝    :https://fire-stm32.taobao.com
  *
  ******************************************************************************
  */ 
	
/*******************************************************************************
  includes
*******************************************************************************/
#include "board.h"
#include "rtthread.h"


/*******************************************************************************
  全局变量声明
*******************************************************************************/
rt_mq_t gp_test_mq = RT_NULL;      /* 定义消息队列控制块句柄 */


/*******************************************************************************
  局部变量声明
*******************************************************************************/
static rt_thread_t __gp_key_thread  = RT_NULL;  /* 按键线程控制块句柄 */


/*******************************************************************************
  局部函数声明
*******************************************************************************/
static void __key_thread_entry (void *parameter);


/*******************************************************************************
  main函数
*******************************************************************************/
/**
  * @brief  主函数
  * @param  无  
  * @retval 无
  */
int main(void)
{  
    /* 创建一个消息队列 */
    gp_test_mq = rt_mq_create("test_mq",
                              20,                /* 消息的最大长度 */
                              5,                 /* 消息队列的最大容量 */
                              RT_IPC_FLAG_FIFO); /* 队列模式 FIFO(0x00) */
    if (gp_test_mq == RT_NULL) {
        rt_kprintf("rt_mq_create err\n");
        return -1;
    }
    
    /* 创建按键线程 */
    __gp_key_thread = rt_thread_create("key",
                                        __key_thread_entry,
                                        RT_NULL,
                                        512,
                                        2,
                                        20);
    if (__gp_key_thread == RT_NULL) {
        rt_kprintf("Failed to create __gp_key_thread\n");
        return -1;
    }
    rt_thread_startup(__gp_key_thread);
    
    return 0;
}


/*******************************************************************************
  线程定义
*******************************************************************************/
static void __key_thread_entry (void *parameter)
{
    char        buf[20];
    
    while (1) {
        rt_mq_recv(gp_test_mq, buf, 20, RT_WAITING_FOREVER);
        rt_kprintf("Received message: %s\n", buf);
        rt_thread_delay(2000);
    }
}


/* end of file */
